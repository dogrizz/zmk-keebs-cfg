/*
 * Copyright (c) 2020 Pete Johanson
 *
 * SPDX-License-Identifier: MIT
 */

#include "cosmo.dtsi"
#include "split_input.dtsi"
#include <input/processors.dtsi>
#include <dt-bindings/zmk/input_transform.h>

&kscan0 {
    col-gpios
        = <&pro_micro 21 GPIO_ACTIVE_HIGH>
        , <&pro_micro 20 GPIO_ACTIVE_HIGH>
        , <&pro_micro 19 GPIO_ACTIVE_HIGH>
        , <&pro_micro 18 GPIO_ACTIVE_HIGH>
        , <&pro_micro 15 GPIO_ACTIVE_HIGH>
        , <&pro_micro 14 GPIO_ACTIVE_HIGH>
        ;
};


&trackball_split_listener { // local trackball input split device child node, receiving events from the peripheral and raising them locally
	status = "okay";
	input-processors = <&zip_xy_transform (INPUT_TRANSFORM_XY_SWAP)>;
};
