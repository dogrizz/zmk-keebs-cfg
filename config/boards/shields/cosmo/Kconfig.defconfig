## config/boards/shields/cosmo/Kconfig.defconfig
```kconfig
if SHIELD_COSMO_LEFT

config ZMK_KEYBOARD_NAME
    default "Cosmo"

config ZMK_SPLIT_ROLE_CENTRAL
    default y

endif

if SHIELD_COSMO_LEFT || SHIELD_COSMO_RIGHT

config ZMK_SPLIT
    default y

config ZMK_POINTING
    default y
endif

if SHIELD_COSMOS_RIGHT
config SPI
    default y
endif
```

## config/west.yml
```yaml
manifest:
  remotes:
    - name: zmkfirmware
      url-base: https://github.com/zmkfirmware
    - name: badjeff
      url-base: https://github.com/badjeff
    - name: nuovotaka
      url-base: https://github.com/nuovotaka
  projects:
    - name: zmk
      remote: zmkfirmware
      revision: v0.3
      import: app/west.yml
    - name: zmk-pmw3610-driver
      remote: badjeff
      revision: zmk-0.3
    - name: zmk-pointing-acceleration-alpha
      remote: nuovotaka
      revision: main
  self:
    path: config
```
