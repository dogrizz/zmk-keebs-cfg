## config/boards/shields/cosmo/Kconfig.shield
```kconfig
# Copyright (c) 2020 Pete Johanson
# SPDX-License-Identifier: MIT

config SHIELD_COSMO_LEFT
    def_bool $(shields_list_contains,cosmo_left)

config SHIELD_COSMO_RIGHT
    def_bool $(shields_list_contains,cosmo_right)
```
