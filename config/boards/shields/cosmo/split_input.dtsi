
/{
    split_inputs { // split input devices
        #address-cells = <1>;
        #size-cells = <0>;

        trackball_split_input: trackball_split_input@0 { // trackball's split input device
            compatible = "zmk,input-split";
            reg = <0>;
        };
    };

    trackball_split_listener: trackball_split_listener { // listener for split input device
        compatible = "zmk,input-listener";
        status = "disabled"; // disable for .keymap to add input processors without undefined reference error
        device = <&trackball_split_input>;
    };
};
